## linux/linux-git/security/anoubis/Kconfig
```kconfig
#
# Anoubis configuration
#

menu "Anoubis framework"

config SECURITY_ANOUBIS
	bool "Anoubis framework"
	depends on SECURITY && EVENTDEV=y
	help
	  This option provides support for the Anoubis framework.

config SECURITY_ANOUBIS_ALF
	tristate "Application Level Firewall module"
	depends on SECURITY_ANOUBIS && SECURITY_NETWORK
	help
	  This option provides support for the Anoubis ALF module

config SECURITY_ANOUBIS_IPC
	tristate "Anoubis IPC Module"
	depends on SECURITY_ANOUBIS && SECURITY_NETWORK
	help
	  This option provides support for the Anoubis IPC module.

config SECURITY_ANOUBIS_SFS
	tristate "Secure Filesystem Module"
	depends on SECURITY_ANOUBIS && SECURITY_PATH && CRYPTO && CRYPTO_SHA256
	help
	  This option provides initial support for the Anoubis SFS module.

config SECURITY_ANOUBIS_PLAYGROUND
	bool "Anoubis Playground feature"
	depends on SECURITY_ANOUBIS
	help
	  This option provides support for the Anoubis Playground feature.
	  This feature provides individual processes with the ability to
	  make modifications to the file system that are only visible to
	  the process itself and its children.

config SECURITY_ANOUBIS_DEBUG
	bool "Anoubis debug messages"
	depends on SECURITY_ANOUBIS
	help
	  This option enables debug messages in Anoubis modules to aid
	  developers finding problems.

config SECURITY_EVENTDEVTEST
	tristate "Test module for Eventdev devices"
	depends on SECURITY_ANOUBIS && SECURITY
	help
	  This is a test module for the eventdev device.

endmenu
```
